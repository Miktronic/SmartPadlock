## boards/arm/smartpadlock/Kconfig.board
```kconfig
# Copyright (c) 2023 Nordic Semiconductor ASA
# SPDX-License-Identifier: Apache-2.0

config BOARD_SMARTPADLOCK
	bool "smartpadlock"
	depends on SOC_NRF52810_QFAA
```

## boards/arm/smartpadlock/Kconfig.defconfig
```kconfig
# Copyright (c) 2023 Nordic Semiconductor ASA
# SPDX-License-Identifier: Apache-2.0

if BOARD_SMARTPADLOCK

config BOARD
	default "smartpadlock"

config BT_CTLR
   default BT

endif
```
